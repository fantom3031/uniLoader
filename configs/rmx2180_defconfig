## configs/rmx2180_defconfig
```kconfig
CONFIG_COMPRESS_GZIP=y
CONFIG_UART_DEBUG=y
CONFIG_SIMPLE_FB=y
CONFIG_MT6765=y
CONFIG_REALME_RMX2180=y
CONFIG_TEXT_BASE=0x40080000
CONFIG_RAMDISK_ENTRY=0x51b00000
CONFIG_PAYLOAD_ENTRY=0x40000000
```
